## drivers/input/touchscreen/Kconfig
```kconfig
#
# Touchscreen driver configuration
#
menuconfig INPUT_TOUCHSCREEN
	bool "Touchscreens"
	help
	  Say Y here, and a list of supported touchscreens will be displayed.
	  This option doesn't affect the kernel.

	  If unsure, say Y.

if INPUT_TOUCHSCREEN

config TOUCHSCREEN_MTK
	bool "MediaTek Touch Panel Driver"
	help
	  Say Y here if you have MediaTek touch panel.

	  If unsure, say N.

	  To compile this driver as a module, choose M here: the
	  module will be called MediaTek touch panel.

if TOUCHSCREEN_MTK
source "drivers/input/touchscreen/mediatek/Kconfig"
endif

config TOUCHSCREEN_MTK
	bool "MediaTek Touch Panel Driver"
	help
	  Say Y here if you have MediaTek touch panel.

config TOUCHSCREEN_MTK_FT5346
	tristate "FT5346 for Mediatek package"
	depends on TOUCHSCREEN_MTK

config TOUCHSCREEN_MTK_ATMEL336T
	tristate "ATMEL336T for Mediatek package"
	depends on TOUCHSCREEN_MTK

config TOUCHSCREEN_SWEEP2WAKE
	tristate "Sweep2Wake for touchscreens"
	select TOUCHSCREEN_PREVENT_SLEEP
	default n

config TOUCHSCREEN_DOUBLETAP2WAKE
	tristate "DoubleTap2Wake for touchscreens"
	select TOUCHSCREEN_PREVENT_SLEEP
	default n

config TOUCHSCREEN_PREVENT_SLEEP
	bool "Inihibit sleep on modified touchscreen drivers"
	default n
	help
	  This disables the sleep function of modified touchscreen drivers.

endif
```

## drivers/input/touchscreen/mediatek/Kconfig
```kconfig
source "drivers/input/touchscreen/mediatek/atmel336t/Kconfig"
source "drivers/input/touchscreen/mediatek/ft5346/Kconfig"
```

## drivers/input/touchscreen/mediatek/atmel336t/Kconfig
```kconfig
config TOUCHSCREEN_MTK_ATMEL336T
	tristate "ATMEL336T touchscreen"
	depends on TOUCHSCREEN_MTK
	help
	  Say Y here if you have a ATMEL336T and want to enable
	  support for the built-in touchscreen.

	  If unsure, say N.
```

## drivers/input/touchscreen/mediatek/ft5346/Kconfig
```kconfig
config TOUCHSCREEN_MTK_FT5346
	tristate "FT5346 touchscreen"
	depends on TOUCHSCREEN_MTK
	help
	  Say Y here if you have a FT5346 and want to enable
	  support for the built-in touchscreen.

	  If unsure, say N.
```

## drivers/misc/mediatek/accelerometer/bmi160_acc/Kconfig
```kconfig
config MTK_BMI160_ACC
	bool "BMI160_ACC for MediaTek package"
	default n
	help
	  If this option is set, it will support
	  BMI160_ACC Accelerometer.
```

## drivers/misc/mediatek/activity_sensor/Kconfig
```kconfig
config CUSTOM_KERNEL_ACTIVITY_SENSOR
	string "CUSTOM_KERNEL_ACTIVITY_SENSOR"
	help
	  Kernel space activity sensor driver.
```

## drivers/misc/mediatek/face_down_sensor/Kconfig
```kconfig
config CUSTOM_KERNEL_FACE_DOWN_SENSOR
	string "CUSTOM_KERNEL_FACE_DOWN_SENSOR"
	help
	  Kernel space face down sensor driver.
```

## drivers/misc/mediatek/glance_gesture_sensor/Kconfig
```kconfig
config CUSTOM_KERNEL_GLANCE_GESTURE_SENSOR
	string "CUSTOM_KERNEL_GLANCE_GESTURE_SENSOR"
	help
	  Kernel space glance(touch wake up) gesture sensor driver.
```

## drivers/misc/mediatek/gyroscope/bmi160_gyro/Kconfig
```kconfig
config MTK_BMI160_GYRO
	bool "BMI160_GYRO for MediaTek package"
	default n
	help
	  If this option is set, it will support
	  BMI160 Gyroscope.
```

## drivers/misc/mediatek/in_pocket_sensor/Kconfig
```kconfig
config CUSTOM_KERNEL_IN_POCKET_SENSOR
	string "CUSTOM_KERNEL_IN_POCKET_SENSOR"
	help
	  Kernel space in pocket detection sensor driver.
```

## drivers/misc/mediatek/lens/Kconfig
```kconfig
config MTK_LENS
  bool CONFIG_MTK_LENS
  default n
  help
    CONFIG_MTK_LENS

source "drivers/misc/mediatek/lens/mt6795/dw9761baf/Kconfig"
```

## drivers/misc/mediatek/pedometer/Kconfig
```kconfig
config CUSTOM_KERNEL_PEDOMETER
	string "CUSTOM_KERNEL_PEDOMETER"
	help
	  Kernel space pedometer sensor driver.
```

## drivers/misc/mediatek/pick_up_sensor/Kconfig
```kconfig
config CUSTOM_KERNEL_PICK_UP_SENSOR
	string "CUSTOM_KERNEL_PICK_UP_SENSOR"
	help
	  Kernel space pick up sensor driver.
```

## drivers/misc/mediatek/tilt_detector_sensor/Kconfig
```kconfig
config CUSTOM_KERNEL_TILT_DETECTOR_SENSOR
	string "CUSTOM_KERNEL_TILT_DETECTOR_SENSOR"
	help
	  Kernel space tilt detector sensor driver.
```

## drivers/misc/mediatek/video/Kconfig
```kconfig
config MTK_VIDEO
  bool CONFIG_MTK_VIDEO
  default n
  help
    CONFIG_MTK_VIDEO

config MTK_VIDEOX
  bool CONFIG_MTK_VIDEOX
  default n
  help
    CONFIG_MTK_VIDEOX
```

## drivers/misc/mediatek/videocodec/Kconfig
```kconfig
# VIDEOCODEC_DRIVER
config MTK_VIDEOCODEC_DRIVER
	tristate "MediaTek VideoCodec Driver"
	default n
	help
	  VideoCodec driver is used to support 
	  Video Playback/Video Recording/Video related features... 
	  which is using MTK solution
```

## drivers/misc/mediatek/wake_gesture_sensor/Kconfig
```kconfig
config CUSTOM_KERNEL_WAKE_GESTURE_SENSOR
	string "CUSTOM_KERNEL_WAKE_GESTURE_SENSOR"
	help
	  Kernel space wake up gesture sensor driver.
```
